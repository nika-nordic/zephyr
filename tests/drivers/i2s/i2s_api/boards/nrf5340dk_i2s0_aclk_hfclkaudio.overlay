/*
 * I2S clock-state case: i2s0 on the audio clock (ACLK) from the HFXO-backed audio PLL.
 *
 * The aclk_hfclkaudio state maps to the ACLK mux and names the &hfclkaudio producer. The audio
 * PLL rate is advertised by the aclk signal's clock-frequency (used to size the prescalers) and
 * must match the clock-frequency the producer is configured with.
 */
&aclk {
	clock-frequency = <12288000>;
};

&hfclkaudio {
	clock-frequency = <12288000>;
};

&i2s0 {
	clocks = <&aclk_hfclkaudio>;
};

/*
 * Copyright (c) 2025 Nordic Semiconductor ASA
 *
 * SPDX-License-Identifier: Apache-2.0
 */

&audiopll {
	status = "okay";
	clock-frequency = <12288000>; /* 12.288 MHz, 48 kHz audio family */
};

&tdm130 {
	mck-frequency = <12288000>;
	mck-clock-source = "ACLK";
	sck-clock-source = "ACLK";
};

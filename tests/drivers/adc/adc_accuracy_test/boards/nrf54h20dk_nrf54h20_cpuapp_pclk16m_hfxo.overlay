/*
 * SPDX-License-Identifier: Apache-2.0
 *
 * Copyright (c) 2026 Nordic Semiconductor ASA
 */

/*
 * SAADC clock state: 16 MHz clock generated by fll16m switched to its HFXO-bypass source for
 * accuracy. The pclk16m_hfxo state names fll16m as its producer with
 * producer-accuracy-ppm = <1> (NRF_CLOCK_CONTROL_ACCURACY_MAX), so the driver requests fll16m
 * with that specification and it selects the HFXO-bypass source (starting the HFXO).
 */
&adc {
	clocks = <&pclk16m_hfxo>;
};

&fll16m {
	status = "okay";
};

&hfxo {
	status = "okay";
};

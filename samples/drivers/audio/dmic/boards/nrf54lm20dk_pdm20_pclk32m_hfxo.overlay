/*
 * PDM clock-state case: pdm20 on the 32 MHz peripheral clock backed by the HFXO.
 *
 * The pclk32m_hfxo state maps to the PCLK32M mux and names the &xo producer, requested so the
 * peripheral runs off the HFXO.
 */
&pdm20 {
	clocks = <&pclk32m_hfxo>;
};

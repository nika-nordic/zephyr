/*
 * Case: nRF54H20, uarte130 as the consumer, 16 MHz clock generated by fll16m in its open-loop
 * (low-accuracy) default.
 *
 * uarte130 is only used to carry the clock state; the sample does not operate the UARTE. The
 * pclk16m_hfint state runs at 16 MHz and has no producer: fll16m's open-loop mode is the default
 * the peripheral runs off automatically, so the sample takes no clock action and just reports the
 * frequency.
 */
/ {
	aliases {
		clk-consumer = &uart130;
	};
};

&uart130 {
	clocks = <&pclk16m_hfint>;
};

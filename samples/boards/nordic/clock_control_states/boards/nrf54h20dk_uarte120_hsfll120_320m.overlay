/*
 * Case: nRF54H20, uarte120 as the consumer, clocked directly by the hsfll120 global HSFLL
 * requested at 320 MHz.
 *
 * uarte120 is only used to carry the clock state; the sample does not operate the UARTE. The
 * hsfll120_320m state has no clock-output (hsfll120 is a DVFS generator with no fixed output
 * rail): the frequency the peripheral runs at is the requested operating point (320 MHz), which
 * is passed to hsfll120 as the nrf_clock_spec frequency so it selects the 320 MHz operating point
 * instead of its lowest default.
 */
/ {
	aliases {
		clk-consumer = &uart120;
	};
};

&uart120 {
	clocks = <&hsfll120_320m>;
};

&hsfll120 {
	status = "okay";
};

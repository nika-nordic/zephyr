## CMakeLists.txt
```
# SPDX-License-Identifier: Apache-2.0

cmake_minimum_required(VERSION 3.28.0)

find_package(Zephyr REQUIRED HINTS $ENV{ZEPHYR_BASE})
project(clock_control_producer)

target_sources(app PRIVATE src/main.c)
```

## prj.conf
```kconfig
# The interesting configuration is per board, see the boards/ overlays and conf files.
# Each board selects a UARTE via the clk-showcase-uart alias, points it at a clock
# producer with the nordic,clock-producer property, and enables a
# CONFIG_UART_NRFX_UARTE_CLOCK_MGMT_* scheme so the producer is requested.
```

## boards/nrf5340dk_nrf5340_cpuapp.conf
```kconfig
CONFIG_UART_ASYNC_API=y

# Use the split clock control driver (nordic,nrf-clock-hfclk) rather than the legacy
# CLOCK_CONTROL_NRF, since the showcase acts on the &hfclk producer from the overlay.
CONFIG_CLOCK_CONTROL_NRF=n

# Request HFXO for uart1 while it is resumed, see the overlay for the reference.
CONFIG_PM_DEVICE=y
CONFIG_PM_DEVICE_RUNTIME=y
CONFIG_UART_NRFX_UARTE_CLOCK_MGMT_ON_PM=y
```

## boards/nrf54l15dk_nrf54l15_cpuapp.conf
```kconfig
CONFIG_UART_ASYNC_API=y

# Request the HFXO producer (xo) for uart30 while it is resumed, see the overlay.
CONFIG_PM_DEVICE=y
CONFIG_PM_DEVICE_RUNTIME=y
CONFIG_UART_NRFX_UARTE_CLOCK_MGMT_ON_PM=y
```

## boards/nrf5340dk_nrf5340_cpuapp.overlay
```dts
/*
 * Showcase of the clock consumer scheme: the UARTE names its clock producer with
 * nordic,clock-producer, so the driver requests HFCLK (and thus HFXO) according to the
 * scheme selected with CONFIG_UART_NRFX_UARTE_CLOCK_MGMT_*. Deleting the property makes
 * the instance keep the clock that the hardware requests automatically (HFINT).
 */
/ {
	aliases {
		clk-showcase-uart = &uart1;
	};
};

&uart1 {
	status = "okay";
	nordic,clock-producer = <&hfclk>;
	current-speed = <9600>;
};

&hfclk {
	status = "okay";
};
```

## boards/nrf54l15dk_nrf54l15_cpuapp.overlay
```dts
/*
 * Showcase of the clock consumer scheme on the nRF54L series. The UARTE names its clock
 * producer with nordic,clock-producer, so the driver requests it according to the scheme
 * selected with CONFIG_UART_NRFX_UARTE_CLOCK_MGMT_*. On this series the requestable HFXO
 * producer is the xo node (nordic,nrf-clock-xo); the hfxo node is only a crystal descriptor
 * and is not backed by a driver. Deleting the property makes the instance keep the clock
 * that the hardware requests automatically. The property is independent of any clocks
 * property, which only describes the base frequency and is left at the SoC default here.
 */
/ {
	aliases {
		clk-showcase-uart = &uart30;
	};
};

&uart30 {
	status = "okay";
	pinctrl-0 = <&uart30_default>;
	pinctrl-1 = <&uart30_sleep>;
	pinctrl-names = "default", "sleep";
	nordic,clock-producer = <&xo>;
	current-speed = <9600>;
};
```

## src/main.c
```c
/*
 * Copyright (c) 2026 Nordic Semiconductor ASA
 *
 * SPDX-License-Identifier: Apache-2.0
 */

#include <stdio.h>
#include <zephyr/device.h>

/* The showcase instance is selected per board with the clk-showcase-uart alias, so that
 * each board can point it at a UARTE that references its own clock producer, see the board
 * overlays.
 */
#define CLK_SHOWCASE_NODE DT_ALIAS(clk_showcase_uart)

#if DT_NODE_EXISTS(CLK_SHOWCASE_NODE) && DT_NODE_HAS_STATUS_OKAY(CLK_SHOWCASE_NODE) && \
	defined(CONFIG_UART_ASYNC_API)
#include <zephyr/drivers/uart.h>

static uint8_t tx_buf[] = {1, 2, 3, 4, 5, 6, 7, 8, 9, 10};

/* Transmit over an instance that references a clock producer with its
 * nordic,clock-producer property, so that the producer is requested by the shim according
 * to the selected CONFIG_UART_NRFX_UARTE_CLOCK_MGMT_* scheme.
 */
static void clk_showcase(void)
{
	const struct device *const uart_dev = DEVICE_DT_GET(CLK_SHOWCASE_NODE);
	int err;

	err = uart_tx(uart_dev, tx_buf, sizeof(tx_buf), SYS_FOREVER_US);
	if (err < 0) {
		printf("uart_tx failed: %d\n", err);
	}
}
#else
static void clk_showcase(void)
{
}
#endif

int main(void)
{
	printf("Clock control producer sample on %s\n", CONFIG_BOARD_TARGET);

	clk_showcase();

	return 0;
}
```

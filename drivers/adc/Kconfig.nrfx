## drivers/adc/Kconfig.nrfx
```kconfig
# ADC configuration options

# Copyright (c) 2018, Nordic Semiconductor ASA
# SPDX-License-Identifier: Apache-2.0

config ADC_NRFX_ADC
	bool "nRF ADC nrfx driver"
	default y
	depends on DT_HAS_NORDIC_NRF_ADC_ENABLED
	select NRFX_ADC
	select ADC_CONFIGURABLE_INPUTS
	help
	  Enable support for nrfx ADC driver for nRF51 MCU series.

config ADC_NRFX_ADC_CHANNEL_COUNT
	int "Number of ADC channels"
	depends on ADC_NRFX_ADC
	range 1 8
	default 1
	help
	  Number of ADC channels to be supported by the driver. Each channel
	  needs a dedicated structure in RAM that stores the ADC settings
	  to be used when sampling this channel.

config ADC_NRFX_SAADC
	bool "nRF SAADC nrfx driver"
	default y
	depends on DT_HAS_NORDIC_NRF_SAADC_ENABLED
	select ADC_CONFIGURABLE_INPUTS
	select NRFX_SAADC
	help
	  Enable support for nrfx SAADC driver.

choice ADC_NRFX_SAADC_CLOCK_MGMT
	prompt "SAADC clock management scheme"
	default ADC_NRFX_SAADC_CLOCK_MGMT_ON_INIT
	depends on ADC_NRFX_SAADC
	help
	  Determines when the driver requests and releases the clock producer of the clock
	  state selected by the `clocks` property of the SAADC node.

	  This only selects the timing, not whether clock management happens at all: the
	  instance is acted upon exactly when it selects a clock state that has a producer
	  (for example pclk16m_hfxo), typically in a devicetree overlay. A state without a
	  producer (pclk16m_hfint) or no `clocks` property is never acted upon regardless of
	  the scheme, so the scheme has no effect and no code is generated for it.

	  Requesting the producer lets the SAADC be clocked by a more accurate source than the
	  one the hardware requests automatically (for example HFXO instead of HFINT), at the
	  cost of the producer startup latency.

config ADC_NRFX_SAADC_CLOCK_MGMT_ON_INIT
	bool "Manage clock on driver initialization"
	help
	  The producer is requested when the driver is initialized and held for as long as the
	  driver exists. The request is issued before the kernel is running, so the driver does
	  not block on it: the producer starts in the background and the SAADC reaches full
	  accuracy once it is up, typically well before the first conversion.

config ADC_NRFX_SAADC_CLOCK_MGMT_ON_PM
	bool "Manage clock on power management transitions"
	depends on PM_DEVICE_RUNTIME
	help
	  The producer is requested when the driver is resumed and released when it is
	  suspended, so it is active for as long as the instance is in use. Because a synchronous
	  read resumes the device ahead of the conversion, the resume blocks until the producer
	  is up, so the conversion is already clocked by it.

config ADC_NRFX_SAADC_CLOCK_MGMT_ON_ACTIVE
	bool "Manage clock for the duration of each conversion"
	help
	  The producer is requested right before a conversion and released once the conversion
	  completes, covering both the synchronous and the asynchronous read paths.

	  A synchronous read (adc_read()) requests the producer from the calling thread and blocks
	  until it is up, so the conversion is clocked by it from the first sample; the release
	  happens in the same thread once the conversion returns. An asynchronous read
	  (adc_read_async()) instead issues the request without blocking and returns immediately; the
	  conversion is triggered once the producer has started, and the release happens when the
	  conversion sequence completes, which may be in the SAADC interrupt.

endchoice
```

## dts/bindings/clock/nordic,clock-consumer.yaml
```yaml
# Common property for Nordic peripherals that can request a clock producer to be
# active while they operate. Include this from a peripheral binding to add the
# optional `nordic,clock-producer` property.

properties:
  nordic,clock-producer:
    type: phandle
    description: |
      Clock producer device to request while the peripheral is clocked, in
      addition to whatever clock the hardware selects automatically. Use it to
      raise the accuracy or rate of the peripheral's clock, for example pointing
      it at the HFXO producer so the peripheral runs off the crystal instead of
      the internal oscillator.

      The referenced node must be a clock-control producer that is backed by a
      driver (for example &hfclk on the nRF53 Series or &xo on the nRF54L
      Series); a bare clock descriptor without a driver (such as a fixed-clock
      node) cannot be requested.

      This is independent of the `clocks` property, which describes the frequency
      the peripheral is clocked at and is not acted upon. When this property is
      absent, the driver takes no clock action and the default clock is used.

      Whether the request is actually issued, and at which point in the device
      lifecycle, is additionally gated by the driver's clock-management Kconfig
      choice (see UART_NRFX_UARTE_CLOCK_MGMT for the UARTE driver).
```

## dts/bindings/clock/nordic,clock-signal.yaml
```yaml
# Copyright (c) 2026 Nordic Semiconductor ASA
# SPDX-License-Identifier: Apache-2.0

description: Nordic clock signal

compatible: "nordic,clock-signal"

include: [base.yaml, clock-controller.yaml]
```

## dts/bindings/clock/nordic,clock-state.yaml
```yaml
# Copyright (c) 2026 Nordic Semiconductor ASA
# SPDX-License-Identifier: Apache-2.0

description: |
  Named clock state of a Nordic nRF peripheral clock.

  A clock state describes one valid way for a peripheral to be clocked: the output that
  determines the frequency, and/or a producer that has to be running for the
  peripheral to be clocked that way. The SoC defines every state that its hardware
  supports, and a clock consumer selects one of them with its `clocks` property:

      &uart30 {
              clocks = <&pclk16m_hfxo>;
      };

  Because the state couples the frequency and the producer, a consumer cannot express an
  invalid combination such as a 16 MHz base clock served by a 128 MHz producer.

  A state node is a pure descriptor; it is not backed by a device. Only the producer it
  references is requested at runtime, and only when the consumer driver is configured to
  act on it (see UART_NRFX_UARTE_CLOCK_MGMT for the UARTE driver). A state without a
  producer therefore means "no runtime action": the peripheral keeps the clock that the
  hardware requests automatically.

compatible: "nordic,clock-state"

include: [base.yaml, clock-controller.yaml]

properties:
  "#clock-cells":
    const: 0

  clock-output:
    type: phandle
    description: |
      Clock output that this state is clocked by, as a reference to a node - typically a
      fixed-clock, or a plain bindingless node for an output whose rate is owned by the
      producer (for example an audio "aclk"). It identifies the hardware clock mux position
      for this state and is never acted upon at runtime. If the output node exposes a
      clock-frequency it provides the frequency the peripheral runs at; if it does not, the
      rate is instead taken from the clock-producer of this state.

      Omit it for a state whose producer is a frequency-selectable (DVFS) generator that
      clocks the peripheral directly with no fixed output rail (for example the nRF54H20
      hsfll120). Such a state has no mux position, and the frequency the peripheral runs at
      is the requested operating point given by producer-frequency-hz (or, absent that, the
      producer's own clock-frequency). A state must have a clock-output, a clock-producer,
      or both.

  clock-producer:
    type: phandle
    description: |
      Clock producer that has to be running for this state, as a reference to a
      clock-control producer node backed by a driver (for example &hfclk on the nRF53
      Series or &xo on the nRF54L Series). Omit it for states that need no runtime action.
      Required when clock-output is omitted.

  producer-frequency-hz:
    type: int
    description: |
      Minimum frequency (in Hz) the producer must provide for this state, mapped to the
      frequency field of the nrf_clock_spec passed to nrf_clock_control_request(). Omit to
      leave the frequency unconstrained (the producer keeps its default). Only meaningful
      together with clock-producer.

  producer-accuracy-ppm:
    type: int
    description: |
      Required producer accuracy (in parts-per-million, lower is stricter), mapped to the
      accuracy field of the nrf_clock_spec. A value of 1 selects the best available accuracy
      (NRF_CLOCK_CONTROL_ACCURACY_MAX). For example, on the nRF54H20 fll16m this selects the
      HFXO-bypass source instead of the open-loop default. Omit to leave accuracy
      unconstrained. Only meaningful together with clock-producer.

  producer-precision:
    type: int
    description: |
      Required producer precision, mapped to the precision field of the nrf_clock_spec
      (0 = default, 1 = high). Omit to leave precision at its default. Only meaningful
      together with clock-producer.
```

## dts/bindings/clock/nordic,fixed-clock.yaml
```yaml
# Copyright (c) 2026 Nordic Semiconductor ASA
# SPDX-License-Identifier: Apache-2.0

description: Nordic fixed-rate clock provider

compatible: "nordic,fixed-clock"

include: [base.yaml, clock-controller.yaml]

properties:
  clock-frequency:
    type: int
    description: output clock frequency (Hz)
    required: true

clock-cells:
  - quality
```

## dts/bindings/clock/nordic,nrf-clock-hfclkaudio.yaml
```yaml
# Copyright (c) 2025 Nordic Semiconductor ASA
# SPDX-License-Identifier: Apache-2.0

description: Nordic nRF HFCLKAUDIO clock control node

compatible: "nordic,nrf-clock-hfclkaudio"

include: base.yaml

properties:

  clock-frequency:
    type: int
    description: |
      Target frequency of the HFCLKAUDIO clock in Hz. The driver rounds it to the
      nearest achievable setting (3.3 ppm resolution) in one of two frequency bands
      - 11.176 MHz to 11.402 MHz, and 12.165 MHz to 12.411 MHz (refer to the relevant
      Product Specification). Preferred over the deprecated hfclkaudio-frequency; it
      gives clock consumers a uniform, target-oriented interface across Nordic audio
      clock producers. The HFCLKAUDIO clock is only available in the nRF53 Series SoCs.

  hfclkaudio-frequency:
    type: int
    deprecated: true
    description: |
      Deprecated in favor of clock-frequency (identical meaning and units). Frequency
      of the HFCLKAUDIO clock in Hz. When both are present, clock-frequency wins.
```

## dts/bindings/clock/nordic,nrfs-audiopll.yaml
```yaml
# Copyright (c) 2024 Nordic Semiconductor ASA
# SPDX-License-Identifier: Apache-2.0

description: Nordic NRFS AudioPLL clock

compatible: "nordic,nrfs-audiopll"

include: base.yaml

properties:
  clock-frequency:
    type: int
    description: |
      Audio PLL output frequency in Hz. This is the preferred property, replacing the
      deprecated frequency. It also advertises the rate to clock consumers that select an
      audio clock state (the aclk signal itself carries no frequency), giving a uniform
      clock-frequency interface across the Nordic audio clock producers (matching auxpll on
      nRF7120 and hfclkaudio on nRF5340).

      See zephyr/include/zephyr/dt-bindings/clock/nrfs-audiopll.h for predefined frequencies.

  frequency:
    type: int
    deprecated: true
    description: |
      Deprecated in favor of clock-frequency. Initial frequency in Hertz. When both this and
      clock-frequency are present, this explicit value takes precedence.

      See zephyr/include/zephyr/dt-bindings/clock/nrfs-audiopll.h for predefined frequencies.
```

## dts/bindings/clock/nordic,variable-clock.yaml
```yaml
# Copyright (c) 2026 Nordic Semiconductor ASA
# SPDX-License-Identifier: Apache-2.0

description: Nordic variable-rate clock provider

compatible: "nordic,variable-clock"

include: [base.yaml, clock-controller.yaml]

properties:
  clock-frequency:
    type: int
    description: output clock frequency (Hz)
    required: true

clock-cells:
  - quality
  - frequency
```

## samples/hello_world/boards/nrf5340dk_nrf5340_cpuapp.conf
```kconfig
CONFIG_UART_ASYNC_API=y
CONFIG_CLOCK_CONTROL_NRF=n

# For macro debugging
CONFIG_COMPILER_SAVE_TEMPS=y
```

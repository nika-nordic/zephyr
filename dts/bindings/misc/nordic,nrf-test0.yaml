## dts/bindings/misc/nordic,nrf-test0.yaml
```yaml
description: Nordic Test 0 (baseline) device

compatible: "nordic,nrf-test0"

include: base.yaml

properties:
  reg:
    required: true
```

## dts/bindings/misc/nordic,nrf-test1.yaml
```yaml
description: Nordic Test 1 device

compatible: "nordic,nrf-test1"

properties:
  test1-required-prop:
    type: int
    required: true
    description: |
      Required property.

include: nordic,nrf-test0.yaml
```

## modules/Kconfig.rpmsg-lite
```kconfig
config RPMSGLITE
	bool "RPMsg-Lite Support"
	help
	  This option enables the RPMsg-Lite IPC library

config RPMSGLITE_FORCE_REMOTE_LINK_UP
	bool "Force link up after remote init"
	depends on RPMSGLITE
	default y
	help
	  This option forces the link to be considered as established after remote init

config RPMSGLITE_USE_STATIC_API
	bool "Disable dynamic memory allocation"
	depends on RPMSGLITE
	default n
	help
	  This option disables dynamic memory allocation
```
